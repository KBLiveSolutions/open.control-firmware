// LED Matrix
byte const MAX_CONCAT = 99;
byte font_5x7[106][3] = {
  {0x00, 0x00, 0x00},  //
  {0x00, 0x3a, 0x00},  // !
  {0x30, 0x00, 0x30},  // "
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  {0x04, 0x00, 0x00}  // open.control caracter 9
  
};


byte column_data[32] = {0, 1, 0, 0, 0, 0, 0, 0, 0, 0, 0, 0, 0, 0, 0, 0, 0, 0, 0, 0, 0, 0, 0, 0, 0, 0, 0, 0, 0, 0, 0, 0};

class Display {
  private:
    byte text_len;
    byte index;
    byte scroller;
    byte  scroller_temp;
    byte ticker;

    void clear_concat() {
      for (byte i = 0; i < MAX_CONCAT; i++) {
        concat_text[i] = 0;
      }
    }

  public:
    byte layout[NUM_LAYOUT] = {0, 0, 0};
   // byte text[MAX_CHAR] = {79, 80, 69, 78, 14, 67, 79, 78, 84, 82, 79, 76};
   // byte text[MAX_CHAR] = {96, 97,98, 99, 100, 101, 102, 103, 104};
    byte text[MAX_CHAR] = {79, 80,  105, 67, 79};
    
    byte concat_text[MAX_CONCAT];

    void clear_text() {
      for (byte i = 0; i < MAX_CHAR; i++) {
        text[i] = 0;
      }
    }
    void build_text(byte text_len) {
      index = 0;
      scroller_temp = 0;
      scroller = 0;
      scrolled = LOW;
      clear_concat();
      text_len = text_len;
      if (text_len < 8) index = (32 - (text_len * 4)) / 2;
      for (int i = 0; i < text_len ; i++) {
        for (byte j = 0; j < 3; j++) {
          if (index < MAX_CONCAT) concat_text[index] = font_5x7[text[i]][j];
          if (font_5x7[text[i]][j] != 0) index ++;
        }
        index ++;
      }
    }
    bool scrolled = LOW;
    void inc_scroll() {
      scroller_temp++;
      if (scroller_temp > 5 && index > MAX_CHAR && !scrolled) scroller++;
      if (scroller > (index - 32)) {
        scroller_temp = 0;
        scroller = 0;
        scrolled = HIGH;
      }
    }

    void tick_on() {
     // delayMicroseconds(50);
      PORTC &= ~(1 << PORTC7);  //C7
      PORTD &= ~(1 << PORTD7);  //D7
    //  delayMicroseconds(20);
    }

    void tick_off() {
      PORTF |= 1 << PORTF1; //F1
      PORTF &= ~(1 << PORTF1);  //F1
      PORTD |= 1 << PORTD6; //D6
      PORTD &= ~(1 << PORTD6);  //D6
      PORTC |= 1 << PORTC7;;  //C7
      PORTD |= 1 << PORTD7;  //D7
    }

    void show_char(int i) {
      tick_off();
      int temp = concat_text[i - 1 + scroller];
      byte data_column = column_data[i];
        if (data_column) PORTF |= 1 << PORTF0;
        else PORTF&= ~(1 << PORTF0);
      for (int j = 0; j < 8; j++) {
        byte data_row = (temp & (0x80));
        if (data_row) PORTB |= 1 << PORTB4;
        else PORTB &= ~(1 << PORTB4);
        temp <<= 1;
        PORTD &= ~(1 << PORTD4); //D4
        PORTD |= 1 << PORTD4; //D4
      }
    //  delayMicroseconds(matrix_brightness);
      PORTF &= ~(1 << PORTF4);  //F4
      PORTF |= 1 << PORTF4;  //F4
      tick_on();
    }
};

Display disp;
